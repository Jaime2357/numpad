## boards/shields/jaime_s_numpad/Kconfig.defconfig
```kconfig
if SHIELD_JAIME_S_NUMPAD

# Name must be less than 16 characters long!
config ZMK_KEYBOARD_NAME
    default "Jaime's Numpad"

endif
```

## boards/shields/jaime_s_numpad/Kconfig.shield
```kconfig
config SHIELD_JAIME_S_NUMPAD
    def_bool $(shields_list_contains,jaime_s_numpad)
```
